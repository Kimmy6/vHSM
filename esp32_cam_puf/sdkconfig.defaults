## esp32_cam_puf/sdkconfig.defaults
```kconfig
# PSRAM (v5.x 올바른 심볼)
CONFIG_SPIRAM=y
CONFIG_SPIRAM_SPEED_80M=y
CONFIG_SPIRAM_USE_MALLOC=y
CONFIG_SPIRAM_MALLOC_ALWAYSINTERNAL=16384

# 콘솔 출력 → UART0 (핵심)
CONFIG_ESP_CONSOLE_UART_DEFAULT=y
CONFIG_ESP_CONSOLE_UART_BAUDRATE=115200

# mbedTLS
CONFIG_MBEDTLS_AES_C=y
CONFIG_ESP_TASK_WDT_EN=n

# Main task stack — app_main uses ~10KB of local buffers
CONFIG_ESP_MAIN_TASK_STACK_SIZE=16384

CONFIG_FATFS_LFN_HEAP=y
CONFIG_FATFS_MAX_LFN=255
```
